## boardspecific/meta-container-bsp-renesas/conf/layer.conf
```bitbake
# We have a conf and classes directory, add to BBPATH
BBPATH =. "${LAYERDIR}:"

# We have recipes-* directories, add to BBFILES
BBFILES += "${LAYERDIR}/recipes-*/*/*.bb \
            ${LAYERDIR}/recipes-*/*/*.bbappend"

BBFILE_COLLECTIONS += "container-bsp-renesas"
BBFILE_PATTERN_container-bsp-renesas = "^${LAYERDIR}/"
BBFILE_PRIORITY_container-bsp-renesas = "81"
LAYERSERIES_COMPAT_container-bsp-renesas = " rocko sumo thud warrior zeus "
```

## conf/layer.conf
```bitbake
# We have a conf and classes directory, add to BBPATH
BBPATH =. "${LAYERDIR}:"

# We have recipes-* directories, add to BBFILES
BBFILES += "${LAYERDIR}/recipes-*/*/*.bb \
            ${LAYERDIR}/recipes-*/*/*.bbappend"

BBFILE_COLLECTIONS += "container-host-example"
BBFILE_PATTERN_container-host-example = "^${LAYERDIR}/"
BBFILE_PRIORITY_container-host-example = "80"
LAYERSERIES_COMPAT_container-host-example = " rocko sumo thud warrior zeus "
```
